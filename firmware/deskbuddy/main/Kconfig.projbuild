## firmware/deskbuddy/main/Kconfig.projbuild
```kconfig
menu "DeskBuddy"

    config DESKBUDDY_STAGE_PERCENT
        int "Character stage width (% of the screen)"
        range 40 100
        default 65
        help
            The rest of the width is the touchscreen control panel (its menu needs at least 352 x 600 pixels, the
            default). The boundary is rounded to 32 pixels so stage and panel redraws never share a dirty-rectangle
            column.

    config DESKBUDDY_PANEL_LEFT
        bool "Put the control-panel area on the left"
        default n

    config DESKBUDDY_BACKLIGHT_PERCENT
        int "Backlight brightness (%)"
        range 3 100
        default 80

    config DESKBUDDY_PERF_LOG_S
        int "Performance log interval in seconds (0 = off)"
        range 0 3600
        default 5

    config DESKBUDDY_DEMO_POKE_S
        int "Poke the character automatically every N seconds (0 = off)"
        range 0 3600
        default 0
        help
            Runs the reaction animations without touching the screen, for hands-off measurements.

    config DESKBUDDY_DEMO_MONSTER_S
        int "Start the Monster Energy animation automatically every N seconds (0 = off)"
        range 0 3600
        default 0
        help
            Plays the Monster charging sequence without touching the screen, for hands-off measurements.
            Normally it is started from the menu (Food & Drink) or by the companion.

    config DESKBUDDY_DEMO_OFFICE_S
        int "Toggle Clock Mode automatically every N seconds (0 = off)"
        range 0 3600
        default 0
        help
            Switches between DeskBuddy and Clock Mode (zooming in and out) without touching the screen, for
            hands-off tests. Normally it is switched on in the menu (Activities -> Clock) and off with a tap.
            (The symbol keeps Clock Mode's first name, Office Mode, so existing configurations stay valid.)

    config DESKBUDDY_DEMO_ACTIVITY_S
        int "Play the next activity (water, sneeze, stare, meditate, the peukie question) every N seconds (0 = off)"
        range 0 3600
        default 0
        help
            Plays the activities in turn without touching the screen, for hands-off measurements; the question
            goes unanswered (a minute, then he is sad). Normally they are started from the menu (Activities, Food &
            Drink).

    config DESKBUDDY_GFX_VERIFY
        bool "Verify every presented frame against a full redraw (debug, slow)"
        default n
        help
            After each incremental redraw, the whole scene is also drawn into a scratch PSRAM buffer and compared
            with the frame about to be shown. Any difference means a missed dirty region. Costs 1.2 MB of PSRAM and
            roughly 100 ms per frame, so animation runs slower while enabled.

endmenu
```
